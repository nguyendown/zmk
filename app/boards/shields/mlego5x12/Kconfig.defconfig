## app/boards/shields/mlego5x12/Kconfig.defconfig
```kconfig
# Copyright (c) 2021 The ZMK Contributors
# SPDX-License-Identifier: MIT

if SHIELD_MLEGO5X12

config ZMK_KEYBOARD_NAME
    default "mlego5x12"

endif

if BUILD_OUTPUT_UF2

config BUILD_OUTPUT_UF2_USE_FLASH_BASE
    default y

config BUILD_OUTPUT_UF2_USE_FLASH_OFFSET
    default y

endif # BUILD_OUTPUT_UF2
```

## app/boards/shields/mlego5x12/Kconfig.shield
```kconfig
# Copyright (c) 2021 The ZMK Contributors
# SPDX-License-Identifier: MIT

config SHIELD_MLEGO5X12
    def_bool $(shields_list_contains,mlego5x12)
```

## app/drivers/zephyr/dts/bindings/kscan/zmk,kscan-gpio-charlieplex.yaml
```yaml
# Copyright (c) 2022 The ZMK Contributors
# SPDX-License-Identifier: MIT

description: Charlieplexing keyscan driver

compatible: "zmk,kscan-gpio-charlieplex"

include: kscan.yaml

properties:
  gpios:
    type: phandle-array
    required: true
  debounce-press-ms:
    type: int
    default: 5
    description: Debounce time for key press in milliseconds. Use 0 for eager debouncing.
  debounce-release-ms:
    type: int
    default: 5
    description: Debounce time for key release in milliseconds.
  debounce-scan-period-ms:
    type: int
    default: 1
    description: Time between reads in milliseconds when any key is pressed.
  poll-period-ms:
    type: int
    default: 10
    description: Time between reads in milliseconds
```
